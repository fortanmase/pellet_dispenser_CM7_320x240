/* USER CODE BEGIN Header */
/**
 ******************************************************************************
 * File Name          : STM32TouchController.cpp
 ******************************************************************************
 * This file is generated by TouchGFX Generator 4.20.0.
 ******************************************************************************
 * @attention
 *
 * Copyright (c) 2023 STMicroelectronics.
 * All rights reserved.
 *
 * This software is licensed under terms that can be found in the LICENSE file
 * in the root directory of this software component.
 * If no LICENSE file comes with this software, it is provided AS-IS.
 *
 ******************************************************************************
 */
/* USER CODE END Header */

/* USER CODE BEGIN STM32TouchController */

#include "stm32h7xx_hal.h"

#include "STM32TouchController.hpp"
#include "config.h"
#include "cst328.h"

static uint16_t xPrev = GUI_WIDTH;
static uint16_t yPrev = GUI_HEIGHT;

void STM32TouchController::init()
{
  /**
   * Initialize touch controller and driver
   *
   */
}

/**
 * By default sampleTouch returns false,
 * return true if a touch has been detected, otherwise false.
 *
 * Coordinates are passed to the caller by reference by x and y.
 *
 * This function is called by the TouchGFX framework.
 * By default sampleTouch is called every tick, this can be adjusted by HAL::setTouchSampleRate(int8_t);
 *
 */

#define VALID_X_MIN_COORD 1U
#define VALID_Y_MIN_COORD 1U
#define VALID_X_MAX_THD_COORD GUI_WIDTH - 1U
#define VALID_Y_MAX_THD_COORD GUI_HEIGHT - 1U
#define VALID_PRESSURE 10U

bool STM32TouchController::sampleTouch(int32_t &x, int32_t &y)
{
  static bool ret = false;
  static uint32_t currentIrqCtr = 0U;
  static uint32_t previousIrqCtr = 0U;
  static uint16_t xCoord;
  static uint16_t yCoord;
  static uint8_t pressure;

  if (CST328_GetTouchPressed())
  {

    currentIrqCtr = CST328_GetIrqCounter();

    if (currentIrqCtr != previousIrqCtr)
    {
      previousIrqCtr = currentIrqCtr;
      bool validTouch = CST328_GetTouchData(1U, &xCoord, &yCoord, &pressure);

      /* clang-format off */
      bool isValidTouch = validTouch                        &&
                          (xCoord > VALID_X_MIN_COORD)      &&
                          (yCoord > VALID_Y_MIN_COORD)      &&
                          (xCoord < VALID_X_MAX_THD_COORD)  &&
                          (yCoord < VALID_Y_MAX_THD_COORD)  &&
                          (pressure > VALID_PRESSURE);
      /* clang-format on */

      ret = isValidTouch;
    }
    else
    {
      currentIrqCtr = 0U;
      previousIrqCtr = 0U;
      CST328_ResetTouchPressed();
    }
  }
  else
  {
    ret = false;
  }

  if (ret)
  {
    x = (int32_t)xCoord;
    y = (int32_t)yCoord;
  }

  return ret;
}

/* USER CODE END STM32TouchController */

/************************ (C) COPYRIGHT STMicroelectronics *****END OF FILE****/
